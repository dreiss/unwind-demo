## CMakeLists.txt
```
cmake_minimum_required(VERSION 3.20.0)
find_package(Zephyr REQUIRED HINTS $ENV{ZEPHYR_BASE})
project(rv32_bt)

# set(CMAKE_C_FLAGS "-Os -fno-omit-frame-pointer")
# set(CMAKE_CXX_FLAGS "-Os -funwind-tables -fexceptions")

zephyr_compile_options(-funwind-tables -fasynchronous-unwind-tables)
#zephyr_ld_options(-Wl,--eh-frame-hdr)

file(GLOB SRC_FILES
"src/*.c"
"src/*.cc"
)
target_sources(app PRIVATE ${SRC_FILES})


add_library(libunwind STATIC IMPORTED GLOBAL)
set_target_properties(libunwind PROPERTIES IMPORTED_LOCATION
  /home/dreiss/stuff/build/libunwind/src/.libs/libunwind.a)
set_target_properties(libunwind PROPERTIES INTERFACE_INCLUDE_DIRECTORIES
  "/home/dreiss/stuff/build/libunwind/include;/home/dreiss/stuff/code/projects/zephyr_libunwind_bridge/include"
)

target_link_libraries(app PUBLIC libunwind)
```

## prj.conf
```kconfig
CONFIG_HEAP_MEM_POOL_SIZE=4096
CONFIG_QEMU_ICOUNT_SLEEP=n
CONFIG_QEMU_ICOUNT=n
# CONFIG_EXCEPTIONS=y
# CONFIG_LIB_CPLUSPLUS=y
# CONFIG_CPLUSPLUS=y
# CONFIG_NEWLIB_LIBC=y
# NEWLIB_LIBC_NANO=n
# CONFIG_PICOLIBC=y
CONFIG_CPLUSPLUS=y
# CONFIG_LIB_CPLUSPLUS=y
# CONFIG_EXCEPTIONS=y
CONFIG_MAIN_STACK_SIZE=65536
```

## src/main.c
```c
#include <stdlib.h>

#include <zephyr/zephyr.h>

#include "app.h"

void run_benchmark(void);

int main() {
  int ret;

  // init_cc(0);
    printk("go = %d\n", 42);


  for (;;) {
    run_benchmark();
    int tot = code1(6, 42);
    printk("tot = %d\n", tot);
    k_msleep(1000);
  }
  return 0;
}

static volatile uint32_t benchmark_output;

void run_benchmark() {
  uint8_t value[64] = {1};
  size_t i = 0;
  uint32_t hash = 0;
  while (i < sizeof(value)) {
    hash += value[i++];
    hash += hash << 10;
    hash ^= hash >> 6;
  }
  hash += hash << 3;
  hash ^= hash >> 11;
  hash += hash << 15;
  benchmark_output = hash;
}
```

## include/link.h
```c
#pragma once

#include <stddef.h>
#include <stdint.h>
//#define ElfW(type)	_ElfW (Elf, __ELF_NATIVE_CLASS, type)
//#define _ElfW(e,w,t)	_ElfW_1 (e, w, _##t)
//#define _ElfW_1(e,w,t)	e##w##t

struct dl_phdr_info {
  uintptr_t dlpi_addr;
  const char *dlpi_name;
  const void* dlpi_phdr;
  uint16_t dlpi_phnum;
};

int dl_iterate_phdr(int(*)(struct dl_phdr_info*, size_t, void*), void*);
```

## include/ucontext.h
```c
#pragma once

#include <assert.h>
#include <stdint.h>

#ifdef __riscv

#if __riscv_flen == 64
#define UCONTEXT_FPREG double
#elif __riscv_flen == 32
#define UCONTEXT_FPREG float
#elif defined(__riscv_float_abi_soft)
#define UCONTEXT_FPREG unused
#else
#error "Unsupported RISC-V floating-point size"
#endif

typedef struct {
  int honk; // XXX
  struct {
    uintptr_t regs[32];
#if !defined(__riscv_float_abi_soft)
    UCONTEXT_FPREG fpregs[32];
    uint32_t fcsf;
#endif
  } uc_mcontext;
} ucontext_t;

#undef UCONTEXT_FPREG

// We need the build system to define this so libunwind can use it in assembly.
// Verify the value, but only if defined.
#ifdef UC_MCONTEXT_REGS_OFF
static_assert(UC_MCONTEXT_REGS_OFF == offsetof(ucontext_t, uc_mcontext));
#endif

#else
#error "Unsupported architecture"
#endif
```

## src/app.h
```c
#include <zephyr/zephyr.h>

#if __cplusplus
extern "C" 
#endif
int code1(int val, int inc);
int code2(int val, int inc);
#if __cplusplus
extern "C"
#endif
int code3(int val, int inc);

#if __cplusplus
extern "C" 
#endif
void init_cc(int val);
```

## src/codes1.c
```c
#include "app.h"

int code1(int val, int inc) {
    int acc = val;
    acc += inc;
    acc = code2(acc, 157);
    acc += inc;
    return acc;
}
```

## src/codes2.c
```c
#include "app.h"

int code2(int val, int inc) {
    int acc = val;
    acc += inc;
    acc = code3(acc, 65000);
    acc += inc;
    return acc;
}
```

## src/codes3.c
```c
#include <unwind.h>

#include "app.h"

#define UNW_LOCAL_ONLY
#include <libunwind.h>

void show_backtrace (void) {
  unw_cursor_t cursor; unw_context_t uc;
  unw_word_t ip, sp;

  unw_getcontext(&uc);
  unw_init_local(&cursor, &uc);
  printk("stack trace:\n");
  while (unw_step(&cursor) > 0) {
    unw_get_reg(&cursor, UNW_REG_IP, &ip);
    //unw_get_reg(&cursor, UNW_REG_SP, &sp);
    //printk("ip = %lx, sp = %lx\n", (long) ip, (long) sp);
    if (unw_is_signal_frame(&cursor)) {
      ip--;
    }
    printk("0x%lx\n", (long) ip);
  }
  printk("\n");






}

void print_bt(void);

int code3(int val, int inc) {
  int acc = val;
  acc += inc;
  printk("acc = %d\n", acc);
  print_bt();
  acc += inc;
  return acc;
}

static _Unwind_Reason_Code frame_cb(struct _Unwind_Context* ctx, void* udata) {
  int before;
  _Unwind_Ptr ip = _Unwind_GetIPInfo(ctx, &before);
  (void)before;
  printk("%p %d\n", (void*)ip, before);
  return _URC_NO_REASON;
}

void print_bt() {
  // throw "honk";

  //_Unwind_Reason_Code ret = _Unwind_Backtrace(frame_cb, NULL);
  //printk("ret: %d\n", ret);

  show_backtrace();
#define BT_BUF_SIZE 64
  // void* bt_buf[BT_BUF_SIZE];
  // int ret = backtrace(bt_buf, BT_BUF_SIZE);
  // for (int i = 0; i < ret; i++) {
  //     printk("bt: %p\n", bt_buf[i]);
  // }
}
```

## src/thing.cc
```c
#include "app.h"
// XXX abort otherwise.  EH not registered?
void init_cc(int val) {
    (void)val;
}
```

## src/unw_embedded.c
```c
#include <stdint.h>

#include <elf.h>
#include <link.h>

extern uint8_t __text_region_start[];
extern uint8_t __text_region_end[];
extern uint8_t __eh_frame_hdr_region_start[];
extern uint8_t __eh_frame_hdr_region_end[];

#if __SIZE_WIDTH__ == 32
typedef Elf32_Phdr Phdr;
#elif __SIZE_WIDTH__ == 64
typedef Elf64_Phdr Phdr;
#else
#error "Can't determine ELF width."
#endif

#define PHNUM 2

int dl_iterate_phdr(int(*callback)(struct dl_phdr_info*, size_t, void*), void* data) {
  Phdr phdrs[PHNUM] = {};
  struct dl_phdr_info phdr_info;
  phdr_info.dlpi_addr = 0;
  phdr_info.dlpi_name = "zephyr";
  phdr_info.dlpi_phdr = phdrs;
  phdr_info.dlpi_phnum = sizeof(phdrs) / sizeof(phdrs[0]);
  // phdrs[0] is text section.
  phdrs[0].p_type = PT_LOAD;
  phdrs[0].p_vaddr = __text_region_start;
  phdrs[0].p_filesz = __text_region_end - __text_region_start;
  phdrs[0].p_memsz = __text_region_end - __text_region_start;
  // XXX check size
  // phdrs[1] is eh_frame_hdr section.
  //phdrs[1].p_type = PT_GNU_EH_FRAME;
  //phdrs[1].p_vaddr = __eh_frame_hdr_region_start;
  //phdrs[1].p_filesz = __eh_frame_hdr_region_end - __eh_frame_hdr_region_start;
  //phdrs[1].p_memsz = __eh_frame_hdr_region_end - __eh_frame_hdr_region_start;

  int cb_ret = callback(&phdr_info, sizeof(phdr_info), data);
  return cb_ret;
}
```
